#pragma once
#include <ArduinoJson.h>
#include "RuntimeSettings.h"
// Only behavior settings cross UART. BLE credentials stay on the selected owner.
inline void roboBehaviorExport(const RuntimeSettings&s,JsonObject out){
  out["schema"]=1;
  out["geminiModel"]=s.geminiModel;
  out["geminiVoice"]=s.geminiVoice;
  out["summaryModel"]=s.summaryModel;
  out["autoMemory"]=s.autoMemory;
  out["backgroundDailyLimit"]=s.backgroundDailyLimit;
  out["speechStyle"]=s.speechStyle;
  out["robotName"]=s.robotName;
  out["speakerGainMilli"]=s.speakerGainMilli;
  out["vadStartX100"]=s.vadStartX100;
  out["vadEndX100"]=s.vadEndX100;
  out["vadEndMs"]=s.vadEndMs;
  out["postSpeakGuardMs"]=s.postSpeakGuardMs;
  out["wakeFollowupMs"]=s.wakeFollowupMs;
  out["timezoneOffsetMin"]=s.timezoneOffsetMin;
  out["inputMode"]=s.inputMode;
  out["memoryEnabled"]=s.memoryEnabled;
  out["proactiveVisual"]=s.proactiveVisual;
  out["proactiveVoice"]=s.proactiveVoice;
  out["interactionMetrics"]=s.interactionMetrics;
  out["privacyMicMuted"]=s.privacyMicMuted;
  out["comfortAlertsEnabled"]=s.comfortAlertsEnabled;
  out["comfortMinTempX10"]=s.comfortMinTempX10;
  out["comfortMaxTempX10"]=s.comfortMaxTempX10;
  out["comfortMinHumidityX10"]=s.comfortMinHumidityX10;
  out["comfortMaxHumidityX10"]=s.comfortMaxHumidityX10;
  out["dailyBriefingEnabled"]=s.dailyBriefingEnabled;
  out["dailyBriefingMinute"]=s.dailyBriefingMinute;
  out["pomodoroFocusMinutes"]=s.pomodoroFocusMinutes;
  out["pomodoroBreakMinutes"]=s.pomodoroBreakMinutes;
  out["pomodoroLongBreakMinutes"]=s.pomodoroLongBreakMinutes;
  out["pomodoroWasActive"]=s.pomodoroWasActive;
  out["pomodoroInterrupted"]=s.pomodoroInterrupted;
  out["notificationAllowlist"]=s.notificationAllowlist;
  out["phonePlatform"]=s.phonePlatform;out["navigationEnabled"]=s.navigationEnabled;
  out["characterIntensity"]=s.characterIntensity;out["notificationSpeechAllowlist"]=s.notificationSpeechAllowlist;
  out["faceLifeEnabled"]=s.faceLifeEnabled;
  out["facePupils"]=s.facePupils;
  out["faceBrows"]=s.faceBrows;
  out["faceLashes"]=s.faceLashes;
  out["faceAutoBrows"]=s.faceAutoBrows;
  out["faceAutoLashes"]=s.faceAutoLashes;
  out["mouthMode"]=s.mouthMode;
  out["facePupilLessActing"]=s.facePupilLessActing;
  out["faceMicroX100"]=s.faceMicroX100;
  out["faceSilhouetteX100"]=s.faceSilhouetteX100;
  out["faceGazeReachX100"]=s.faceGazeReachX100;
  out["masterSound"]=s.masterSound;
  out["speechEnabled"]=s.speechEnabled;
  out["characterSfx"]=s.characterSfx;
  out["wakeSfx"]=s.wakeSfx;
  out["touchSfx"]=s.touchSfx;
  out["motionSfx"]=s.motionSfx;
  out["notificationSfx"]=s.notificationSfx;
  out["sonicFrequency"]=s.sonicFrequency;
  out["quietHoursEnabled"]=s.quietHoursEnabled;
  out["sfxIntensityX100"]=s.sfxIntensityX100;
  out["quietStartMin"]=s.quietStartMin;
  out["quietEndMin"]=s.quietEndMin;
  out["quietGainX100"]=s.quietGainX100;
}
inline bool roboBehaviorSettingsEqual(const RuntimeSettings&a,const RuntimeSettings&b){
  JsonDocument leftDoc,rightDoc;roboBehaviorExport(a,leftDoc.to<JsonObject>());roboBehaviorExport(b,rightDoc.to<JsonObject>());
  if(leftDoc.overflowed()||rightDoc.overflowed())return false;
  return leftDoc.as<JsonObjectConst>()==rightDoc.as<JsonObjectConst>();
}
inline bool roboBehaviorImport(JsonObjectConst in,RuntimeSettings&out){
  if(in["schema"].as<int>()!=1)return false;
  RuntimeSettings next=out;
  if(!in["geminiModel"].is<const char*>()||strlen(in["geminiModel"].as<const char*>())>=sizeof(next.geminiModel))return false;
  RuntimeSettings::copy(next.geminiModel,sizeof(next.geminiModel),in["geminiModel"]);
  if(!in["geminiVoice"].is<const char*>()||strlen(in["geminiVoice"].as<const char*>())>=sizeof(next.geminiVoice))return false;
  RuntimeSettings::copy(next.geminiVoice,sizeof(next.geminiVoice),in["geminiVoice"]);
  if(!in["summaryModel"].is<const char*>()||strlen(in["summaryModel"].as<const char*>())>=sizeof(next.summaryModel))return false;
  RuntimeSettings::copy(next.summaryModel,sizeof(next.summaryModel),in["summaryModel"]);
  if(!in["autoMemory"].is<uint8_t>())return false;
  next.autoMemory=in["autoMemory"].as<uint8_t>();
  if(!in["backgroundDailyLimit"].is<uint8_t>())return false;
  next.backgroundDailyLimit=in["backgroundDailyLimit"].as<uint8_t>();
  if(!in["speechStyle"].is<const char*>()||strlen(in["speechStyle"].as<const char*>())>=sizeof(next.speechStyle))return false;
  RuntimeSettings::copy(next.speechStyle,sizeof(next.speechStyle),in["speechStyle"]);
  if(!in["robotName"].is<const char*>()||strlen(in["robotName"].as<const char*>())>=sizeof(next.robotName))return false;
  RuntimeSettings::copy(next.robotName,sizeof(next.robotName),in["robotName"]);
  if(!in["speakerGainMilli"].is<uint16_t>())return false;
  next.speakerGainMilli=in["speakerGainMilli"].as<uint16_t>();
  if(!in["vadStartX100"].is<uint16_t>())return false;
  next.vadStartX100=in["vadStartX100"].as<uint16_t>();
  if(!in["vadEndX100"].is<uint16_t>())return false;
  next.vadEndX100=in["vadEndX100"].as<uint16_t>();
  if(!in["vadEndMs"].is<uint16_t>())return false;
  next.vadEndMs=in["vadEndMs"].as<uint16_t>();
  if(!in["postSpeakGuardMs"].is<uint16_t>())return false;
  next.postSpeakGuardMs=in["postSpeakGuardMs"].as<uint16_t>();
  if(!in["wakeFollowupMs"].is<uint16_t>())return false;
  next.wakeFollowupMs=in["wakeFollowupMs"].as<uint16_t>();
  if(!in["timezoneOffsetMin"].is<int16_t>())return false;
  next.timezoneOffsetMin=in["timezoneOffsetMin"].as<int16_t>();
  if(!in["inputMode"].is<uint8_t>())return false;
  next.inputMode=in["inputMode"].as<uint8_t>();
  if(!in["memoryEnabled"].is<uint8_t>())return false;
  next.memoryEnabled=in["memoryEnabled"].as<uint8_t>();
  if(!in["proactiveVisual"].is<uint8_t>())return false;
  next.proactiveVisual=in["proactiveVisual"].as<uint8_t>();
  if(!in["proactiveVoice"].is<uint8_t>())return false;
  next.proactiveVoice=in["proactiveVoice"].as<uint8_t>();
  if(!in["interactionMetrics"].is<uint8_t>())return false;
  next.interactionMetrics=in["interactionMetrics"].as<uint8_t>();
  if(!in["privacyMicMuted"].is<uint8_t>())return false;
  next.privacyMicMuted=in["privacyMicMuted"].as<uint8_t>();
  if(!in["comfortAlertsEnabled"].is<uint8_t>())return false;
  next.comfortAlertsEnabled=in["comfortAlertsEnabled"].as<uint8_t>();
  if(!in["comfortMinTempX10"].is<int16_t>())return false;
  next.comfortMinTempX10=in["comfortMinTempX10"].as<int16_t>();
  if(!in["comfortMaxTempX10"].is<int16_t>())return false;
  next.comfortMaxTempX10=in["comfortMaxTempX10"].as<int16_t>();
  if(!in["comfortMinHumidityX10"].is<uint16_t>())return false;
  next.comfortMinHumidityX10=in["comfortMinHumidityX10"].as<uint16_t>();
  if(!in["comfortMaxHumidityX10"].is<uint16_t>())return false;
  next.comfortMaxHumidityX10=in["comfortMaxHumidityX10"].as<uint16_t>();
  if(!in["dailyBriefingEnabled"].is<uint8_t>())return false;
  next.dailyBriefingEnabled=in["dailyBriefingEnabled"].as<uint8_t>();
  if(!in["dailyBriefingMinute"].is<uint16_t>())return false;
  next.dailyBriefingMinute=in["dailyBriefingMinute"].as<uint16_t>();
  if(!in["pomodoroFocusMinutes"].is<uint8_t>())return false;
  next.pomodoroFocusMinutes=in["pomodoroFocusMinutes"].as<uint8_t>();
  if(!in["pomodoroBreakMinutes"].is<uint8_t>())return false;
  next.pomodoroBreakMinutes=in["pomodoroBreakMinutes"].as<uint8_t>();
  if(!in["pomodoroLongBreakMinutes"].is<uint8_t>())return false;
  next.pomodoroLongBreakMinutes=in["pomodoroLongBreakMinutes"].as<uint8_t>();
  if(!in["pomodoroWasActive"].is<uint8_t>())return false;
  next.pomodoroWasActive=in["pomodoroWasActive"].as<uint8_t>();
  if(!in["pomodoroInterrupted"].is<uint8_t>())return false;
  next.pomodoroInterrupted=in["pomodoroInterrupted"].as<uint8_t>();
  if(!in["notificationAllowlist"].is<const char*>()||strlen(in["notificationAllowlist"].as<const char*>())>=sizeof(next.notificationAllowlist))return false;
  RuntimeSettings::copy(next.notificationAllowlist,sizeof(next.notificationAllowlist),in["notificationAllowlist"]);
  // Optional additions preserve the v1 settings contract with older peers.
  if(!in["phonePlatform"].isUnbound()){if(!in["phonePlatform"].is<uint8_t>()||in["phonePlatform"].as<uint8_t>()>1)return false;next.phonePlatform=in["phonePlatform"];}
  if(!in["navigationEnabled"].isUnbound()){if(!in["navigationEnabled"].is<uint8_t>()||in["navigationEnabled"].as<uint8_t>()>1)return false;next.navigationEnabled=in["navigationEnabled"];}
  if(!in["characterIntensity"].isUnbound()){if(!in["characterIntensity"].is<uint8_t>()||in["characterIntensity"].as<uint8_t>()>2)return false;next.characterIntensity=in["characterIntensity"];}
  if(!in["notificationSpeechAllowlist"].isUnbound()){if(!in["notificationSpeechAllowlist"].is<const char*>()||strlen(in["notificationSpeechAllowlist"].as<const char*>())>=sizeof(next.notificationSpeechAllowlist))return false;RuntimeSettings::copy(next.notificationSpeechAllowlist,sizeof(next.notificationSpeechAllowlist),in["notificationSpeechAllowlist"]);}
  if(!in["faceLifeEnabled"].is<uint8_t>())return false;
  next.faceLifeEnabled=in["faceLifeEnabled"].as<uint8_t>();
  if(!in["facePupils"].is<uint8_t>())return false;
  next.facePupils=in["facePupils"].as<uint8_t>();
  if(!in["faceBrows"].is<uint8_t>())return false;
  next.faceBrows=in["faceBrows"].as<uint8_t>();
  if(!in["faceLashes"].is<uint8_t>())return false;
  next.faceLashes=in["faceLashes"].as<uint8_t>();
  if(!in["faceAutoBrows"].is<uint8_t>())return false;
  next.faceAutoBrows=in["faceAutoBrows"].as<uint8_t>();
  if(!in["faceAutoLashes"].is<uint8_t>())return false;
  next.faceAutoLashes=in["faceAutoLashes"].as<uint8_t>();
  if(!in["mouthMode"].is<uint8_t>())return false;
  next.mouthMode=in["mouthMode"].as<uint8_t>();
  if(!in["facePupilLessActing"].is<uint8_t>())return false;
  next.facePupilLessActing=in["facePupilLessActing"].as<uint8_t>();
  if(!in["faceMicroX100"].is<uint16_t>())return false;
  next.faceMicroX100=in["faceMicroX100"].as<uint16_t>();
  if(!in["faceSilhouetteX100"].is<uint16_t>())return false;
  next.faceSilhouetteX100=in["faceSilhouetteX100"].as<uint16_t>();
  if(!in["faceGazeReachX100"].is<uint16_t>())return false;
  next.faceGazeReachX100=in["faceGazeReachX100"].as<uint16_t>();
  if(!in["masterSound"].is<uint8_t>())return false;
  next.masterSound=in["masterSound"].as<uint8_t>();
  if(!in["speechEnabled"].is<uint8_t>())return false;
  next.speechEnabled=in["speechEnabled"].as<uint8_t>();
  if(!in["characterSfx"].is<uint8_t>())return false;
  next.characterSfx=in["characterSfx"].as<uint8_t>();
  if(!in["wakeSfx"].is<uint8_t>())return false;
  next.wakeSfx=in["wakeSfx"].as<uint8_t>();
  if(!in["touchSfx"].is<uint8_t>())return false;
  next.touchSfx=in["touchSfx"].as<uint8_t>();
  if(!in["motionSfx"].is<uint8_t>())return false;
  next.motionSfx=in["motionSfx"].as<uint8_t>();
  if(!in["notificationSfx"].is<uint8_t>())return false;
  next.notificationSfx=in["notificationSfx"].as<uint8_t>();
  if(!in["sonicFrequency"].is<uint8_t>())return false;
  next.sonicFrequency=in["sonicFrequency"].as<uint8_t>();
  if(!in["quietHoursEnabled"].is<uint8_t>())return false;
  next.quietHoursEnabled=in["quietHoursEnabled"].as<uint8_t>();
  if(!in["sfxIntensityX100"].is<uint16_t>())return false;
  next.sfxIntensityX100=in["sfxIntensityX100"].as<uint16_t>();
  if(!in["quietStartMin"].is<uint16_t>())return false;
  next.quietStartMin=in["quietStartMin"].as<uint16_t>();
  if(!in["quietEndMin"].is<uint16_t>())return false;
  next.quietEndMin=in["quietEndMin"].as<uint16_t>();
  if(!in["quietGainX100"].is<uint16_t>())return false;
  next.quietGainX100=in["quietGainX100"].as<uint16_t>();
  if(next.inputMode>2||next.timezoneOffsetMin< -720||next.timezoneOffsetMin>840||next.speakerGainMilli<50||next.speakerGainMilli>1000||next.comfortMinTempX10>=next.comfortMaxTempX10||next.comfortMinHumidityX10>=next.comfortMaxHumidityX10)return false;
  out=next;return true;
}
